## Kconfig
```kconfig
config MQUICKJS
    bool "mquickjs Javascript Engine"
    default y
    help
      Enable the mquickjs lightweight Javascript engine.

if MQUICKJS

config MQUICKJS_USE_FPU
    bool "Use Hardware FPU"
    default y if FPU
    help
      If enabled, mquickjs will use the system's floating point unit.
      If disabled, it will use its internal software float implementation (libm.c).

endif
```
